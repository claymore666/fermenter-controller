## sdkconfig.defaults
```kconfig
# ESP32-S3 with 16MB flash
CONFIG_ESPTOOLPY_FLASHSIZE_16MB=y
CONFIG_PARTITION_TABLE_CUSTOM=y
CONFIG_PARTITION_TABLE_CUSTOM_FILENAME="partitions.csv"

# USB Serial/JTAG Console - use USB as primary console
CONFIG_ESP_CONSOLE_USB_SERIAL_JTAG=y
# Prevent light sleep when USB connected (USB doesn't work during/after light sleep)
CONFIG_USJ_NO_AUTO_LS_ON_CONNECTION=y

# WiFi SmartConfig
CONFIG_ESP_SMARTCONFIG_ENABLE=y

# FreeRTOS Runtime Stats (for CPU usage monitoring)
CONFIG_FREERTOS_USE_TRACE_FACILITY=y
CONFIG_FREERTOS_GENERATE_RUN_TIME_STATS=y
CONFIG_FREERTOS_USE_STATS_FORMATTING_FUNCTIONS=y

# Power Management - Enable for light sleep support
CONFIG_PM_ENABLE=y
CONFIG_PM_DFS_INIT_AUTO=y

# CPU Frequency - Use 80MHz for power saving
CONFIG_ESP_DEFAULT_CPU_FREQ_MHZ_80=y

# FreeRTOS tickless idle - Required for automatic light sleep
CONFIG_FREERTOS_USE_TICKLESS_IDLE=y

# Light Sleep - Allow WiFi to maintain connection during sleep
CONFIG_ESP_WIFI_SLP_IRAM_OPT=y
CONFIG_ESP_WIFI_SLP_DEFAULT_MIN_ACTIVE_TIME=50
CONFIG_ESP_WIFI_SLP_DEFAULT_MAX_ACTIVE_TIME=10

# mbedTLS X509 certificate generation is enabled via -DCERT_GENERATION_ENABLED in platformio.ini
# ESP-IDF already enables: MBEDTLS_X509_CRT_WRITE_C, MBEDTLS_X509_CREATE_C, MBEDTLS_PK_WRITE_C

# TLS 1.3 Support
CONFIG_MBEDTLS_SSL_PROTO_TLS1_3=y

# WebSocket Support (used when WEBSOCKET_ENABLED)
CONFIG_HTTPD_WS_SUPPORT=y

# SSL buffer sizes for TLS sessions
# Input buffer 16KB for full TLS record support (required for OTA from GitHub)
# Output buffer 4KB (smaller, as we send less data)
CONFIG_MBEDTLS_ASYMMETRIC_CONTENT_LEN=y
CONFIG_MBEDTLS_SSL_IN_CONTENT_LEN=16384
CONFIG_MBEDTLS_SSL_OUT_CONTENT_LEN=4096

# Certificate Bundle for HTTPS client (OTA from GitHub, etc.)
# Required for esp_crt_bundle_attach() to work
CONFIG_MBEDTLS_CERTIFICATE_BUNDLE=y
CONFIG_MBEDTLS_CERTIFICATE_BUNDLE_DEFAULT_FULL=y

# Allow plain HTTP for OTA updates (for local network servers)
CONFIG_ESP_HTTPS_OTA_ALLOW_HTTP=y
CONFIG_OTA_ALLOW_HTTP=y
```
